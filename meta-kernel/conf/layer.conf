## meta-kernel/conf/layer.conf
```bitbake
BBPATH .= ":${LAYERDIR}"
BBFILES += "${LAYERDIR}/recipes-*/*/*.bb \
            ${LAYERDIR}/recipes-*/*/*.bbappend"

BBFILE_COLLECTIONS += "meta-kernel"
BBFILE_PATTERN_meta-kernel = "^${LAYERDIR}/"
BBFILE_PRIORITY_meta-kernel = "6"

LAYERSERIES_COMPAT_meta-kernel = "kirkstone zeus"
```
